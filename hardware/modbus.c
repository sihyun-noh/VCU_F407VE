#include "modbus.h"
#include "PWM.h"
#include "232_1_modbus.h"
#include "led.h"



u8	modbus_slave_addr = 1;					//从机地址
u8	modbus_Tx_buff[100];					//发送缓冲区
u16 modbus_virtual_register[10]={1,20,3,41,52,6,7,8,9,0}; //虚拟寄存器



/* 发送数据函数，buff为发送内容，len表示发送字节数 */
void modbus_send_data(u8 *buff,u8 len)
{
	for(int i = 0;i<len;i++)
	{
		 RS232_1_SendByte(buff[i]);
	}
}


/* modbus服务函数 */
void modbus_service(void)
{	
	u16 data_CRC_value;   		//从机收到的CRC校验码
	u16 data_len;         		//从机收到的modbus数据长度
	u16 CRC_check_result; 		//从机根据收到的数据计算出来的CRC校验码
	if(USART_RX_STA&0x8000)     //串口接收完成的标志
	{
		data_len = USART_RX_STA & 0x3fff ; 			
		CRC_check_result = COMM_CrcValueCalc(USART_RX_BUF,data_len-2);
		data_CRC_value = USART_RX_BUF[data_len-1]<<8 | (((u16)USART_RX_BUF[data_len-2])); //对于CRC的接收，先接收低位，再接收高位
		if( CRC_check_result == data_CRC_value )
		{
			if(USART_RX_BUF[0]==modbus_slave_addr)
			{
				switch(USART_RX_BUF[1])
				{
					case 03:      //读多个寄存器
					{
						
						modbus_03_function();
						break;
					}
					case 06:      //写单个寄存器
					{
						modbus_06_function();
						break;
					}
					case 16:      //写多个寄存器
					{
						modbus_16_function();
						break;
					}
				}
			}
		}
		USART_RX_STA=0;  //开始下一次接收
	}
}


//读保持寄存器的从机端
void modbus_03_function(void)
{

	u16 i;
	u16 arr_start=3;   		//从机回复寄存器的值是从数组的第四个值开始，索引要写3
	u16 register_len;  		//查询寄存器的数量
	u16 register_start;		//查询寄存器的起始地址
	modbus_Tx_buff[0] = modbus_slave_addr;
	modbus_Tx_buff[1] = 03;
	register_len = USART_RX_BUF[5]|(((u16)USART_RX_BUF[4])<<8); 						//拿到接收的保持寄存器的个数
	modbus_Tx_buff[2] = register_len * 2;												//一个寄存器两个字节，将要发送的字节数给到modbus_Tx_buff，为在包中的第3个数据
	register_start = USART_RX_BUF[3]|(((u16)USART_RX_BUF[2])<<8);						//将要读取的地址的数据的地址给到register_start
	
	for(i=0 ; (register_len*2) >i ; i++,register_start++)									//通过模拟虚拟寄存器将该地址的数据给到modbus_Tx_buff从包中的第3位开始
	{	
		//rt_kprintf("register_start = %d\n",register_start);
//		modbus_Tx_buff[arr_start] = modbus_virtual_register[register_start]>>8&0xFF;         
//		arr_start++;
//		modbus_Tx_buff[arr_start] = modbus_virtual_register[register_start]&0xFF;
//		arr_start++;
//		modbus_Tx_buff[arr_start] = (EEPROM_ReadByteData(register_start))>>8&0xFF;		//将eeprom中的数据放入modbus的发送数组中
//		arr_start++;
		modbus_Tx_buff[arr_start] = (EEPROM_ReadByteData(register_start))&0xFF;
		arr_start++;
	}
	
	arr_start = COMM_CrcValueCalc(modbus_Tx_buff,register_len*2+3);
	modbus_Tx_buff[register_len*2+3] = (arr_start)&0xFF;         						//每个数据占1个字节，前面有从机地址、功能码、字节数所以+3，register_len*2是数据所占的空间，所以校验码在最后
	modbus_Tx_buff[register_len*2+4] = (arr_start>>8)&0xFF;
	modbus_send_data(modbus_Tx_buff,register_len*2+5);

}


//主机对从机写单个寄存器
void modbus_06_function(void)
{
	u16 register_addr;				//主机想要修改从机的指定寄存器编号
	
	modbus_Tx_buff[0]=USART_RX_BUF[0];
	modbus_Tx_buff[1]=USART_RX_BUF[1];
	modbus_Tx_buff[2]=USART_RX_BUF[2];
	modbus_Tx_buff[3]=USART_RX_BUF[3];
	modbus_Tx_buff[4]=USART_RX_BUF[4];
	modbus_Tx_buff[5]=USART_RX_BUF[5];
	
	register_addr = USART_RX_BUF[3]|(((u16)USART_RX_BUF[2])<<8);										//将要写入的地址register_addr
//	modbus_virtual_register[register_addr] = USART_RX_BUF[5]|(((u16)USART_RX_BUF[4])<<8);				
	
	EEPROM_WriteByteData(register_addr,USART_RX_BUF[4]);//将数据写入eeprom的指定地址因为要占两个字节，所以高位在前，也就是高位在低地址处，低位在高地址处
	EEPROM_WriteByteData(register_addr+1,USART_RX_BUF[5]);
	
	register_addr=COMM_CrcValueCalc(modbus_Tx_buff,6);
	modbus_Tx_buff[6]=(register_addr)&0xFF;
	modbus_Tx_buff[7]=(register_addr>>8)&0xFF;
	
	modbus_send_data(modbus_Tx_buff,8);
}


void modbus_16_function(void)
{
	u16 i;
	u16 register_start;	   	   //修改寄存器的起始地址
	u16 register_num;		   //修改寄存器的数量
	u16 CRC_check_result;  	   //CRC校验的结果
	modbus_Tx_buff[0]=USART_RX_BUF[0];
	modbus_Tx_buff[1]=USART_RX_BUF[1];
	modbus_Tx_buff[2]=USART_RX_BUF[2];
	modbus_Tx_buff[3]=USART_RX_BUF[3];
	modbus_Tx_buff[4]=USART_RX_BUF[4];
	modbus_Tx_buff[5]=USART_RX_BUF[5];
	CRC_check_result=COMM_CrcValueCalc(modbus_Tx_buff,6);
	modbus_Tx_buff[6]=(CRC_check_result)&0xFF;
	modbus_Tx_buff[7]=(CRC_check_result>>8)&0xFF;
	
	register_start = USART_RX_BUF[3]|(((u16)USART_RX_BUF[2])<<8);  
	register_num = USART_RX_BUF[5]|(((u16)USART_RX_BUF[4])<<8);  
	for( i =0;i<register_num;i++)
	{
		modbus_virtual_register[register_start+i] = USART_RX_BUF[8+i*2]|(((u16)USART_RX_BUF[7+i*2])<<8);
	}
	modbus_send_data(modbus_Tx_buff,8);
	
}

//unsigned int CRC16(unsigned char *puchMsg,  unsigned char usDataLen)/* 函数以 unsigned short 类型返回 CRC */
///* puchMsg 用于计算 CRC 的报文 */
///* usDataLen 报文中的字节数 */
//{ 

//	unsigned char uchCRCHi = 0xFF ; /* CRC 的高字节初始化 */
//	unsigned char uchCRCLo = 0xFF ; /* CRC 的低字节初始化 */
//	unsigned short int uIndex ; /* CRC 查询表索引 */
//  unsigned char auchCRCHi[] = { 
//		0x00, 0xC1, 0x81, 0x40, 0x01, 0xC0, 0x80, 0x41, 0x01, 0xC0, 0x80, 0x41,
//		0x00, 0xC1, 0x81,
//		0x40, 0x01, 0xC0, 0x80, 0x41, 0x00, 0xC1, 0x81, 0x40, 0x00, 0xC1, 0x81,
//		0x40, 0x01, 0xC0,
//		0x80, 0x41, 0x01, 0xC0, 0x80, 0x41, 0x00, 0xC1, 0x81, 0x40, 0x00, 0xC1,
//		0x81, 0x40, 0x01,
//		0xC0, 0x80, 0x41, 0x00, 0xC1, 0x81, 0x40, 0x01, 0xC0, 0x80, 0x41, 0x01,
//		0xC0, 0x80, 0x41,
//		0x00, 0xC1, 0x81, 0x40, 0x01, 0xC0, 0x80, 0x41, 0x00, 0xC1, 0x81, 0x40,
//		0x00, 0xC1, 0x81,
//		0x40, 0x01, 0xC0, 0x80, 0x41, 0x00, 0xC1, 0x81, 0x40, 0x01, 0xC0, 0x80,
//		0x41, 0x01, 0xC0,
//		0x80, 0x41, 0x00, 0xC1, 0x81, 0x40, 0x00, 0xC1, 0x81, 0x40, 0x01, 0xC0,
//		0x80, 0x41, 0x01,
//		0xC0, 0x80, 0x41, 0x00, 0xC1, 0x81, 0x40, 0x01, 0xC0, 0x80, 0x41, 0x00,
//		0xC1, 0x81, 0x40,
//		0x00, 0xC1, 0x81, 0x40, 0x01, 0xC0, 0x80, 0x41, 0x01, 0xC0, 0x80, 0x41,
//		0x00, 0xC1, 0x81,
//		0x40, 0x00, 0xC1, 0x81, 0x40, 0x01, 0xC0, 0x80, 0x41, 0x00, 0xC1, 0x81,
//		0x40, 0x01, 0xC0,
//		0x80, 0x41, 0x01, 0xC0, 0x80, 0x41, 0x00, 0xC1, 0x81, 0x40, 0x00, 0xC1,
//		0x81, 0x40, 0x01,
//		0xC0, 0x80, 0x41, 0x01, 0xC0, 0x80, 0x41, 0x00, 0xC1, 0x81, 0x40, 0x01,
//		0xC0, 0x80, 0x41,
//		0x00, 0xC1, 0x81, 0x40, 0x00, 0xC1, 0x81, 0x40, 0x01, 0xC0, 0x80, 0x41,
//		0x00, 0xC1, 0x81,
//		0x40, 0x01, 0xC0, 0x80, 0x41, 0x01, 0xC0, 0x80, 0x41, 0x00, 0xC1, 0x81,
//		0x40, 0x01, 0xC0,
//		0x80, 0x41, 0x00, 0xC1, 0x81, 0x40, 0x00, 0xC1, 0x81, 0x40, 0x01, 0xC0,
//		0x80, 0x41, 0x01,
//		0xC0, 0x80, 0x41, 0x00, 0xC1, 0x81, 0x40, 0x00, 0xC1, 0x81, 0x40, 0x01,
//		0xC0, 0x80, 0x41,
//		0x00, 0xC1, 0x81, 0x40, 0x01, 0xC0, 0x80, 0x41, 0x01, 0xC0, 0x80, 0x41,
//		0x00, 0xC1, 0x81,
//		0x40
//    } ;  
//	unsigned char auchCRCLo[] = {  
//		0x00, 0xC0, 0xC1, 0x01, 0xC3, 0x03, 0x02, 0xC2, 0xC6, 0x06, 0x07, 0xC7,
//		0x05, 0xC5, 0xC4,
//		0x04, 0xCC, 0x0C, 0x0D, 0xCD, 0x0F, 0xCF, 0xCE, 0x0E, 0x0A, 0xCA, 0xCB,
//		0x0B, 0xC9, 0x09,
//		0x08, 0xC8, 0xD8, 0x18, 0x19, 0xD9, 0x1B, 0xDB, 0xDA, 0x1A, 0x1E, 0xDE,
//		0xDF, 0x1F, 0xDD,
//		0x1D, 0x1C, 0xDC, 0x14, 0xD4, 0xD5, 0x15, 0xD7, 0x17, 0x16, 0xD6, 0xD2,
//		0x12, 0x13, 0xD3,
//		0x11, 0xD1, 0xD0, 0x10, 0xF0, 0x30, 0x31, 0xF1, 0x33, 0xF3, 0xF2, 0x32,
//		0x36, 0xF6, 0xF7,
//		0x37, 0xF5, 0x35, 0x34, 0xF4, 0x3C, 0xFC, 0xFD, 0x3D, 0xFF, 0x3F, 0x3E,
//		0xFE, 0xFA, 0x3A,
//		0x3B, 0xFB, 0x39, 0xF9, 0xF8, 0x38, 0x28, 0xE8, 0xE9, 0x29, 0xEB, 0x2B,
//		0x2A, 0xEA, 0xEE,
//		0x2E, 0x2F, 0xEF, 0x2D, 0xED, 0xEC, 0x2C, 0xE4, 0x24, 0x25, 0xE5, 0x27,
//		0xE7, 0xE6, 0x26,
//		0x22, 0xE2, 0xE3, 0x23, 0xE1, 0x21, 0x20, 0xE0, 0xA0, 0x60, 0x61, 0xA1,
//		0x63, 0xA3, 0xA2,
//		0x62, 0x66, 0xA6, 0xA7, 0x67, 0xA5, 0x65, 0x64, 0xA4, 0x6C, 0xAC, 0xAD,
//		0x6D, 0xAF, 0x6F,
//		0x6E, 0xAE, 0xAA, 0x6A, 0x6B, 0xAB, 0x69, 0xA9, 0xA8, 0x68, 0x78, 0xB8,
//		0xB9, 0x79, 0xBB,
//		0x7B, 0x7A, 0xBA, 0xBE, 0x7E, 0x7F, 0xBF, 0x7D, 0xBD, 0xBC, 0x7C, 0xB4,
//		0x74, 0x75, 0xB5,
//		0x77, 0xB7, 0xB6, 0x76, 0x72, 0xB2, 0xB3, 0x73, 0xB1, 0x71, 0x70, 0xB0,
//		0x50, 0x90, 0x91,
//		0x51, 0x93, 0x53, 0x52, 0x92, 0x96, 0x56, 0x57, 0x97, 0x55, 0x95, 0x94,
//		0x54, 0x9C, 0x5C,
//		0x5D, 0x9D, 0x5F, 0x9F, 0x9E, 0x5E, 0x5A, 0x9A, 0x9B, 0x5B, 0x99, 0x59,
//		0x58, 0x98, 0x88,
//		0x48, 0x49, 0x89, 0x4B, 0x8B, 0x8A, 0x4A, 0x4E, 0x8E, 0x8F, 0x4F, 0x8D,
//		0x4D, 0x4C, 0x8C,
//		0x44, 0x84, 0x85, 0x45, 0x87, 0x47, 0x46, 0x86, 0x82, 0x42, 0x43, 0x83,
//		0x41, 0x81, 0x80,
//		0x40
//    } ;
 
//   while (usDataLen--) /* 完成整个报文缓冲区 */
//	{
//		uIndex = uchCRCLo ^ *puchMsg++ ; /* 计算 CRC */
//		uchCRCLo = uchCRCHi ^ auchCRCHi[uIndex] ;
//		uchCRCHi = auchCRCLo[uIndex] ;
//	}
//	return (uchCRCHi << 8 | uchCRCLo) ;
//}


//获取校验码函数
/* data 用于计算 CRC 的报文 */
/* length 报文中的字节数 */
u16 COMM_CrcValueCalc(const u8 *data,u16 length)
{
	u16 crcValue=0xffff;
	int i;
	while(length--)
	{
		crcValue^=*data++;
		for(i=0;i<8;i++)
		{
			if(crcValue&0x0001)
			{
				crcValue=(crcValue>>1)^0xA001;
			}
			else
			{
				crcValue=crcValue>>1;
			}
		}
	}
    return(crcValue);
}


/*
功能：开启线程通过sbus和can控制小车行走
参数：
	
*/
static void Modbus_thread_entry(void *parameter)
{
	while(1)
	{
		
		modbus_service();
		rt_thread_delay(1);										//在main函数运行开启线程的时候需要线程让出CPU资源，保证cpu可以运行开启后面的线程。
	}
}


/* 定义线程控制块 */
static rt_thread_t Modbus_thread = RT_NULL;

int bsp_Modbus_thread(void)
{
	
	Modbus_thread =                          /* 线程控制块指针 */
    rt_thread_create( "Modbus",              /* 线程名字 */
                      Modbus_thread_entry,   /* 线程入口函数 */
                      RT_NULL,             /* 线程入口函数参数 */
                      512,                 /* 线程栈大小 */
                      3,                   /* 线程的优先级 */
                      20);                 /* 线程时间片 */
                   
    /* 启动线程，开启调度 */
   if (Modbus_thread != RT_NULL)
        rt_thread_startup(Modbus_thread);
    else
        return -1;   

}

